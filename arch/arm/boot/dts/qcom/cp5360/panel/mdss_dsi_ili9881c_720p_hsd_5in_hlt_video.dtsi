&mdss_mdp {
	mdss_dsi_ili9881c_720p_hsd_5in_hlt_video: qcom,mdss_dsi_ili9881c_720p_hsd_5in_hlt_video {
		qcom,cont-splash-enabled;
		qcom,mdss-dsi-bl-max-level = <0xff>;
		qcom,mdss-dsi-bl-min-level = <0x01>;
		qcom,mdss-dsi-bl-pmic-bank-select = <0x00>;
		qcom,mdss-dsi-bl-pmic-control-type = "bl_ctrl_pwm";
		qcom,mdss-dsi-bl-pmic-pwm-frequency = <0x64>;
		qcom,mdss-dsi-bllp-eof-power-mode;
		qcom,mdss-dsi-bllp-power-mode;
		qcom,mdss-dsi-border-color = <0x00>;
		qcom,mdss-dsi-bpp = <0x18>;
		qcom,mdss-dsi-color-order = "rgb_swap_rgb";
		qcom,mdss-dsi-dma-trigger = "trigger_sw";
		qcom,mdss-dsi-h-back-porch = <0x78>;
		qcom,mdss-dsi-h-front-porch = <0x50>;
		qcom,mdss-dsi-h-left-border = <0x00>;
		qcom,mdss-dsi-h-pulse-width = <0x14>;
		qcom,mdss-dsi-h-right-border = <0x00>;
		qcom,mdss-dsi-h-sync-pulse = <0x01>;
		qcom,mdss-dsi-h-sync-skew = <0x00>;
		qcom,mdss-dsi-lane-0-state;
		qcom,mdss-dsi-lane-1-state;
		qcom,mdss-dsi-lane-2-state;
		qcom,mdss-dsi-lane-3-state;
		qcom,mdss-dsi-lane-map = "lane_map_0123";
		qcom,mdss-dsi-mdp-trigger = "none";
		qcom,mdss-dsi-off-command = [05 01 00 00 00 00 02 28 00 05 01 00 00 78 00 02 10 00];
		qcom,mdss-dsi-off-command-state = "dsi_hs_mode";
		qcom,mdss-dsi-on-command = [29 01 00 00 00 00 04 ff 98 81 03 29 01 00 00 00 00 02 01 00 29 01 00 00 00 00 02 02 00 29 01 00 00 00 00 02 03 72 29 01 00 00 00 00 02 04 00 29 01 00 00 00 00 02 05 00 29 01 00 00 00 00 02 06 09 29 01 00 00 00 00 02 07 00 29 01 00 00 00 00 02 08 00 29 01 00 00 00 00 02 09 01 29 01 00 00 00 00 02 0a 00 29 01 00 00 00 00 02 0b 00 29 01 00 00 00 00 02 0c 01 29 01 00 00 00 00 02 0d 00 29 01 00 00 00 00 02 0e 00 29 01 00 00 00 00 02 0f 00 29 01 00 00 00 00 02 10 00 29 01 00 00 00 00 02 11 00 29 01 00 00 00 00 02 12 00 29 01 00 00 00 00 02 13 00 29 01 00 00 00 00 02 14 00 29 01 00 00 00 00 02 15 00 29 01 00 00 00 00 02 16 00 29 01 00 00 00 00 02 17 00 29 01 00 00 00 00 02 18 00 29 01 00 00 00 00 02 19 00 29 01 00 00 00 00 02 1a 00 29 01 00 00 00 00 02 1b 00 29 01 00 00 00 00 02 1c 00 29 01 00 00 00 00 02 1d 00 29 01 00 00 00 00 02 1e 40 29 01 00 00 00 00 02 1f 80 29 01 00 00 00 00 02 20 05 29 01 00 00 00 00 02 21 02 29 01 00 00 00 00 02 22 00 29 01 00 00 00 00 02 23 00 29 01 00 00 00 00 02 24 00 29 01 00 00 00 00 02 25 00 29 01 00 00 00 00 02 26 00 29 01 00 00 00 00 02 27 00 29 01 00 00 00 00 02 28 33 29 01 00 00 00 00 02 29 02 29 01 00 00 00 00 02 2a 00 29 01 00 00 00 00 02 2b 00 29 01 00 00 00 00 02 2c 00 29 01 00 00 00 00 02 2d 00 29 01 00 00 00 00 02 2e 00 29 01 00 00 00 00 02 2f 00 29 01 00 00 00 00 02 30 00 29 01 00 00 00 00 02 31 00 29 01 00 00 00 00 02 32 00 29 01 00 00 00 00 02 33 00 29 01 00 00 00 00 02 34 04 29 01 00 00 00 00 02 35 00 29 01 00 00 00 00 02 36 00 29 01 00 00 00 00 02 37 00 29 01 00 00 00 00 02 38 3c 29 01 00 00 00 00 02 39 00 29 01 00 00 00 00 02 3a 40 29 01 00 00 00 00 02 3b 40 29 01 00 00 00 00 02 3c 00 29 01 00 00 00 00 02 3d 00 29 01 00 00 00 00 02 3e 00 29 01 00 00 00 00 02 3f 00 29 01 00 00 00 00 02 40 00 29 01 00 00 00 00 02 41 00 29 01 00 00 00 00 02 42 00 29 01 00 00 00 00 02 43 00 29 01 00 00 00 00 02 44 00 29 01 00 00 00 00 02 50 01 29 01 00 00 00 00 02 51 23 29 01 00 00 00 00 02 52 45 29 01 00 00 00 00 02 53 67 29 01 00 00 00 00 02 54 89 29 01 00 00 00 00 02 55 ab 29 01 00 00 00 00 02 56 01 29 01 00 00 00 00 02 57 23 29 01 00 00 00 00 02 58 45 29 01 00 00 00 00 02 59 67 29 01 00 00 00 00 02 5a 89 29 01 00 00 00 00 02 5b ab 29 01 00 00 00 00 02 5c cd 29 01 00 00 00 00 02 5d ef 29 01 00 00 00 00 02 5e 11 29 01 00 00 00 00 02 5f 01 29 01 00 00 00 00 02 60 00 29 01 00 00 00 00 02 61 15 29 01 00 00 00 00 02 62 14 29 01 00 00 00 00 02 63 0e 29 01 00 00 00 00 02 64 0f 29 01 00 00 00 00 02 65 0c 29 01 00 00 00 00 02 66 0d 29 01 00 00 00 00 02 67 06 29 01 00 00 00 00 02 68 02 29 01 00 00 00 00 02 69 07 29 01 00 00 00 00 02 6a 02 29 01 00 00 00 00 02 6b 02 29 01 00 00 00 00 02 6c 02 29 01 00 00 00 00 02 6d 02 29 01 00 00 00 00 02 6e 02 29 01 00 00 00 00 02 6f 02 29 01 00 00 00 00 02 70 02 29 01 00 00 00 00 02 71 02 29 01 00 00 00 00 02 72 02 29 01 00 00 00 00 02 73 02 29 01 00 00 00 00 02 74 02 29 01 00 00 00 00 02 75 01 29 01 00 00 00 00 02 76 00 29 01 00 00 00 00 02 77 14 29 01 00 00 00 00 02 78 15 29 01 00 00 00 00 02 79 0e 29 01 00 00 00 00 02 7a 0f 29 01 00 00 00 00 02 7b 0c 29 01 00 00 00 00 02 7c 0d 29 01 00 00 00 00 02 7d 06 29 01 00 00 00 00 02 7e 02 29 01 00 00 00 00 02 7f 07 29 01 00 00 00 00 02 80 02 29 01 00 00 00 00 02 81 02 29 01 00 00 00 00 02 82 02 29 01 00 00 00 00 02 83 02 29 01 00 00 00 00 02 84 02 29 01 00 00 00 00 02 85 02 29 01 00 00 00 00 02 86 02 29 01 00 00 00 00 02 87 02 29 01 00 00 00 00 02 88 02 29 01 00 00 00 00 02 89 02 29 01 00 00 00 00 02 8a 02 29 01 00 00 00 00 04 ff 98 81 04 29 01 00 00 00 00 02 6c 15 29 01 00 00 00 00 02 6e 2a 29 01 00 00 00 00 02 6f 34 29 01 00 00 00 00 02 3a 94 29 01 00 00 00 00 02 8d 14 29 01 00 00 00 00 02 87 ba 29 01 00 00 00 00 02 26 76 29 01 00 00 00 00 02 b2 d1 29 01 00 00 00 00 02 b5 06 29 01 00 00 00 00 04 ff 98 81 01 29 01 00 00 00 00 02 22 0a 29 01 00 00 00 00 02 31 00 29 01 00 00 00 00 02 53 85 29 01 00 00 00 00 02 55 8f 29 01 00 00 00 00 02 50 85 29 01 00 00 00 00 02 51 a0 29 01 00 00 00 00 02 60 08 29 01 00 00 00 00 02 a0 08 29 01 00 00 00 00 02 a1 10 29 01 00 00 00 00 02 a2 18 29 01 00 00 00 00 02 a3 01 29 01 00 00 00 00 02 a4 1c 29 01 00 00 00 00 02 a5 2c 29 01 00 00 00 00 02 a6 1e 29 01 00 00 00 00 02 a7 20 29 01 00 00 00 00 02 a8 53 29 01 00 00 00 00 02 a9 22 29 01 00 00 00 00 02 aa 2d 29 01 00 00 00 00 02 ab 46 29 01 00 00 00 00 02 ac 1e 29 01 00 00 00 00 02 ad 17 29 01 00 00 00 00 02 ae 4c 29 01 00 00 00 00 02 af 22 29 01 00 00 00 00 02 b0 1f 29 01 00 00 00 00 02 b1 43 29 01 00 00 00 00 02 b2 5d 29 01 00 00 00 00 02 b3 39 29 01 00 00 00 00 02 c0 08 29 01 00 00 00 00 02 c1 14 29 01 00 00 00 00 02 c2 1d 29 01 00 00 00 00 02 c3 1a 29 01 00 00 00 00 02 c4 01 29 01 00 00 00 00 02 c5 16 29 01 00 00 00 00 02 c6 0d 29 01 00 00 00 00 02 c7 15 29 01 00 00 00 00 02 c8 65 29 01 00 00 00 00 02 c9 14 29 01 00 00 00 00 02 ca 1f 29 01 00 00 00 00 02 cb 60 29 01 00 00 00 00 02 cc 12 29 01 00 00 00 00 02 cd 10 29 01 00 00 00 00 02 ce 43 29 01 00 00 00 00 02 cf 15 29 01 00 00 00 00 02 d0 24 29 01 00 00 00 00 02 d1 50 29 01 00 00 00 00 02 d2 5e 29 01 00 00 00 00 02 d3 39 29 01 00 00 00 00 04 ff 98 81 00 05 01 00 00 c4 00 02 11 00 05 01 00 00 32 00 02 29 00];
		qcom,mdss-dsi-on-command-state = "dsi_lp_mode";
		qcom,mdss-dsi-panel-controller = <&mdss_dsi0>;
		qcom,mdss-dsi-panel-destination = "display_1";
		qcom,mdss-dsi-panel-framerate = <0x3c>;
		qcom,mdss-dsi-panel-height = <0x500>;
		qcom,mdss-dsi-panel-name = "ili9881c 720p hsd helitai video mode dsi panel";
		qcom,mdss-dsi-panel-timings = <0x7a1a1200 0x3e42165a 0x14030400>;
		qcom,mdss-dsi-panel-type = "dsi_video_mode";
		qcom,mdss-dsi-panel-width = <0x2d0>;
		qcom,mdss-dsi-pwm-gpio = <&pm8909_mpps 0x04 0x00>;
		qcom,mdss-dsi-reset-sequence = <0x01 0x05 0x00 0x14 0x01 0x78>;
		qcom,mdss-dsi-stream = <0x00>;
		qcom,mdss-dsi-t-clk-post = <0x1f>;
		qcom,mdss-dsi-t-clk-pre = <0x2d>;
		qcom,mdss-dsi-traffic-mode = "burst_mode";
		qcom,mdss-dsi-underflow-color = <0xff>;
		qcom,mdss-dsi-v-back-porch = <0x12>;
		qcom,mdss-dsi-v-bottom-border = <0x00>;
		qcom,mdss-dsi-v-front-porch = <0x14>;
		qcom,mdss-dsi-v-pulse-width = <0x08>;
		qcom,mdss-dsi-v-top-border = <0x00>;
		qcom,mdss-dsi-virtual-channel-id = <0x00>;
	};
};
