/* Copyright (c) 2014-2015, The Linux Foundation. All rights reserved.
 *
 * This program is free software; you can redistribute it and/or modify
 * it under the terms of the GNU General Public License version 2 and
 * only version 2 as published by the Free Software Foundation.
 *
 * This program is distributed in the hope that it will be useful,
 * but WITHOUT ANY WARRANTY; without even the implied warranty of
 * MERCHANTABILITY or FITNESS FOR A PARTICULAR PURPOSE.  See the
 * GNU General Public License for more details.
 */

/dts-v1/;

#include "msm8909-qrd-skuc.dtsi"

#include "cp5360/android.dtsi"
#include "cp5360/battery.dtsi"
#include "cp5360/camera.dtsi"
#include "cp5360/display.dtsi"
#include "cp5360/misc.dtsi"
#include "cp5360/pinctrl.dtsi"
#include "cp5360/sensors.dtsi"
#include "cp5360/soc.dtsi"
#include "cp5360/storage.dtsi"
#include "cp5360/touchscreen.dtsi"

/ {
	qcom,board-id = <0x1000b 0x08 0x11000b 0x08 0x21000b 0x08>;
};
