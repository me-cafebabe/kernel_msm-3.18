## drivers/platform/Kconfig
```kconfig
if X86
source "drivers/platform/x86/Kconfig"
endif
source "drivers/platform/goldfish/Kconfig"

source "drivers/platform/chrome/Kconfig"

if ARCH_MSM
source "drivers/platform/msm/Kconfig"
endif

config MACH_XIAOMI_PRADA
	bool "PRADA"
	help
	  PRADA
```
